;**************************************************************************************
; 
;  Freescale(TM) and the Freescale logo are trademarks of Freescale Semiconductor, Inc. 
;  All other product or service names are the property of their respective owners. 
;  (c) Copyright 2014 - 2015 Freescale Semiconductor Inc.
;  Copyright 2017 NXP
;  All Rights Reserved.
; 
;  You can use this example for any purpose on any computer system with the
;  following restrictions:
;
;  1. This example is provided "as is", without warranty.
;
;  Description: T32 programming script
;
;**************************************************************************************

; Start-Up Script for s32gxxv4
;========================================================================
; CPU setup

local &elfname
entry &elfname


; initilize SRAM
Data.Set EA:0x34000000--0x34020000 %quad 0xDEADBEEFDEADBEEF

; Load code
; update this patch according to your installation folder
Data.LOAD.ELF Output\image.elf /GLOBTYPES /GT /MW /BUGFIX

;DATA.LIST
;SYMBOL.BROWSE.FUNCTION
BREAK.RESET
v.w ui32_ms_cnt task_1 task_2 task_3 idle_task error_sync uxInterruptNested

; simulate reset event
Register.Set PC el2_Reset_Handler

; increase trace buffer size
trace.size 10485760.

; the main breakpoint can be used to trigger the TCL procedure that updates the SEMA4 properties
b.s main
b.s vPortInterruptDispatcher

ENDDO

