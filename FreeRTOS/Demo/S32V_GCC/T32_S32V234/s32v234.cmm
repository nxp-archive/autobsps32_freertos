
;Assuming the M4 is the master core and the A53 is started later

LOCAL &elf_file
ENTRY &elf_file

RESet
SYStem.CPU S32V-CM4
SYStem.CONFIG.DEBUGPORTTYPE JTAG
SYStem.Option.ResBreak OFF
sys.option.DUALPORT on
Trace.DISable    // Maybe required
SYStem.Up

; initilize M4 TCM memory 32k+32k
Data.Set EA:0x1E000000--0x1E007fff %quad 0x0
Data.Set EA:0x3E000000--0x3E007fff %quad 0x0


; mode init
; MC_ME
d.s 0x4004A008 %word 0x00ff		; enable all modes
d.s 0x4004A080 %word 0x00ff		; enable all peripherals to be active during all modes except of RESET

; FXOSC settings
; FXOSC.CTL.B.EOCV = 0xA0
; FXOSC.CTL.B.OSCBYP = 0x0
; FXOSC.CTL.B.GM_SEL = 0x7
d.s 0x4003C280 %Long 0x01a02070

; enable xosc and firc oscillators and select xosc as sysclk.
d.s 0x4004A030 %word 0x0031	
d.s 0x4004A004 %long 0x40005AF0             ; Mode & Key
d.s 0x4004A004 %long 0x4000A50F             ; Mode & Key
WHILE ((DATA.LONG(ANC:0x4004A000))&0x08000000)!=0x00000000 
while ((DATA.LONG(ANC:0x4004A000))&0x00000020)==0x00000000 
wait 1s

d.s 0x4004A270 %long 0x00001110
d.s 0x4004A004 %long 0x40005AF0             ; Mode & Key
d.s 0x4004A004 %long 0x4000A50F             ; Mode & Key
WHILE ((DATA.LONG(ANC:0x4004A000))&0x08000000)!=0x00000000 
wait 0.2s

Data.Load.Elf &elf_file /GLOBTYPES

; SP init
r.s r13 __BOOT_STACK_ADDRESS

list


ENDDO
