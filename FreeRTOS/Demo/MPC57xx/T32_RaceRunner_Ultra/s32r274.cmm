;
; Copyright 2018 NXP
;


;local &filename
;entry &filename

;=== elf-file for debugging ===
&filename="../OUT/GEN_001"
&optimizePLL=0

;set titles
Title "RaceRunner Ultra "

;arrange debugger windows
; framepos      5.    5. 150.  50.

;set equal paths
&pwd=os.pwd()


;=========================================================================
; System settings
;=========================================================================
; CPU setup
SYStem.RESet
SYStem.BdmClock 2.0MHz
SYStem.CPU S32R274
SYStem.CONFIG.CORE 3. 1.
SYStem.CONFIG.Slave OFF
SYStem.Option.WATCHDOG OFF
SYStem.OPTION DUALPORT ON
SYStem.Option.SLOWRESET ON
SYStem.DETECT CPU
SYStem.Up



;switch to HLL mode debugging
MODE.HLL


wait 500ms


;initialize internal SRAM.
Data.Set EA:0x40000000--0x4005FFFF %quad 0x0


map.bonchip 0x0--0x4005ffff


DO flash.cmm &filename


;display source
Data.List

;clear all breakpoints
Break.delete /ALL

R.S IP _start

register /sl

v.w ui32_ms_cnt sBlockingConsumerCount  sBlockingProducerCount



ENDDO



