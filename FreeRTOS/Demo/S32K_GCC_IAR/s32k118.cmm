; Script for programming of S32K118.
;
; This file contains sample code only. It is not part of the production code deliverables
; Copyright 2018 NXP
;========================================================================
LOCAL &load_to
LOCAL &elf_file
LOCAL &load_params
LOCAL &core_no
LOCAL &rchw
LOCAL &derivative_cpu
LOCAL &PFlashSize &DFlashSize

ENTRY &load_to &elf_file &load_params &core_no

&optimizeFLSMODE=0

;=========================================================================
; Variables settings
;=========================================================================

;=========================================================================
; System settings
;=========================================================================

;cpu settings - S32K118, S32K118
system.reset
SYStem.Option TRST on
SYStem.Option ResBreak on
SYStem.Option WaitReset ON
SYS.CPU S32K118
system.config.debugporttype SWD
SYStem.JtagClock 4MHz
sys.up

; Disable Bootrom
;GOSUB DisableBootrom
; Disable watchdog
;GOSUB DisableWatchdog

IF CPUIS(S32K118)
(
    &derivative_cpu="S32K118"
)
ELSE
(
    PRINT %ERROR "FLASH size of CPU type is not supported by the script"
    ENDDO
)


;=========================================================================
; RAM initialization
;=========================================================================

print "Starting RAM initialization:"
; Initialize internal SRAM (17KB)
IF CPUIS(S32K118)
(
    Data.Set A:0x1FFFFC00--0X200057FF  %Quad 0
)
ELSE
(
    PRINT %ERROR "FLASH size of CPU type is not supported by the script"
    ENDDO
)

IF "&load_to"=="flash"
(
;=========================================================================
; Flash declaration
;=========================================================================
print "Starting FLASH sector creation:"
    FLASH.RESet
    IF CPUIS("S32K116")
    (
        &PFlashSize=0x20000
        &DFlashSize=0x08000
    )
    ELSE IF CPUIS(S32K118)
    (
        &PFlashSize=0x40000
        &DFlashSize=0x08000
    )
    ELSE
    (
        PRINT %ERROR "FLASH size of CPU type is not supported by the script"
        ENDDO
    )

    IF &PFlashSize>=0x20000
        FLASH.Create 1. 0x00000000--0x0001FFFF 0x800 TARGET Quad
    IF &PFlashSize>=0x40000
        FLASH.Create 1. 0x00020000--0x0003FFFF 0x1000 TARGET Quad

    FLASH.TARGET 0x20000000 0x20001000 0x1000 ~~/demo/arm/flash/quad/s32k.bin
)
;========================================================================
; Flash programming example
;
; Flash programming speed is about three times faster when memory class E:
; is used for data buffer (DUALPORT memory access). For DUALPORT access it
; is required to setup MemAccess NEXUS for both, NEXUS and JTAG debugger.

; put the core in RUN mode (if the core is in HSRUN flash commands do not work)
data.set 0x4007e00c %long 0x0

IF "&load_to"=="flash"
(
   IF &optimizeFLSMODE==1
   (
      FLASH.Reprogram ALL
      Data.Load.Elf &elf_file /GLOBTYPES
      FLASH.Reprogram OFF

   )
   ELSE
   (
      ; Read the LAST word of FLASH Config area
      &FLASH_CFG_W4=data.long(ANC:0x40C)
      &FLASH_CFG_W4_DISABLEROM=(&FLASH_CFG_W4&0x0000FFFF)
      ;Check if ROM & Secure Boot are disabled

      IF (&FLASH_CFG_W4_DISABLEROM==0x7FFE)
      (
        FLASH.Reprogram ALL /ERASE
        Data.Load.Elf &elf_file /GLOBTYPES
        FLASH.Reprogram OFF
      )
      ELSE
      (
        ; re-write the Flash Config area 0x400 as specified in the elf.
        FLASH.AUTO.ALL /CENSORSHIP
        Data.Load.Elf &elf_file /GLOBTYPES
        FLASH.AUTO.OFF
      )
    )
)
ELSE IF "&load_to"=="ERASE_ONLY"
(
   flash.unlock all
   flash.auto off
   flash.ERASE ALL
   ENDDO
)
TrOnchip.Set CORERESET OFF

system.reset
SYStem.Option TRST off
SYStem.Option ResBreak on
SYStem.Option WaitReset ON
SYStem.CPU &derivative_cpu
system.config.debugporttype SWD 
SYStem.JtagClock 4MHz
sys.up

; Disable watchdog
;GOSUB DisableWatchdog

;load program (if FLASH selected than load only debug symbols)
IF "&load_to"=="flash"
(
   Data.Load.Elf &elf_file /GLOBTYPES /NOCODE
)
ELSE
(
   ; initialize internam SRAM
   Data.Load.Elf &elf_file /GLOBTYPES

)

WinCLEAR
list
WinPOS 84.125 0.0 63. 41. 0. 0. W001
Per , /SPOTLIGHT

WinPOS 84.25 45.0 63. 12. 0. 0. W000
Register /SPOTLIGHT
; simulate reset event
Register.Set PC  __startup
; use this for GHS and GCC
Register.Set R13 __StackLimit

ENDDO

DisableBootrom:
  Data.Set SD:0x4007F010 %LE %Long 0x6
  Data.Set SD:0x4007F014 %LE %Long 0x0
  RETURN

DisableWatchdog:

   IF CPUIS("S32K118")
   (
       D.S SD:0x20000000 %BE %Long 0x0
       D.S SD:0x20000004 %BE %Long 0x0
       D.S SD:0x20000008 %BE %Long 0x0
       D.S SD:0x2000000C %BE %Long 0x0
       D.S SD:0x20000010 %BE %Long 0x0
   )
  ; The watchdog has a restrictive timing. It has to be configured and unlocked within a peripod
  ; of 128 cycles. Therefor the unlock sequence need to be done by a small target program.

  Data.Assemble ST:0x20000000  str  r1, [r0]
  Data.Assemble ,              str  r3, [r2]
  Data.Assemble ,              str  r5, [r4]
  Data.Assemble ,              bkpt #0

  Register.Set PC 0x20000000
  Register.Set SP 0x20001000

  ; Set R0 equal to address of WDOG CNT register
  Register.Set  r0 0x40052004
  ; Set R1 equal to unlock sequence 0xC520 then 0xD928
  Register.Set  r1 0xD928C520
  ; Set R2 equal to address of WDOG TOVAL register
  Register.Set  r2 0x40052008
  ; Set R3 equal to value of 0xFFFF that need to set for WDOG TOVAL
  Register.Set  r3 0x0000FFFF
  ; Set R4 equal to address of WDOG CS register
  Register.Set  r4 0x40052000
  ; Set R5 equal to value of WDOG CS EN bit equal to 0 (disabled)
  Register.Set  r5 0x00002120

  Go.direct
  WAIT !RUN()

  tronchip.set HARDERR off
  tronchip.set INTERR off
  tronchip.set BUSERR off
  tronchip.set STATERR off
  tronchip.set CHKERR off
  tronchip.set NOCPERR off
  tronchip.set MMERR off
  RETURN
