;
; Copyright 2018, 2020 NXP
;

LOCAL &elf_file
ENTRY &elf_file

&elf_file="Output\image.elf"

SYStem.Reset
Break.RESet
SYStem.CPU S32K344-M7-0
SYStem.Config.core 1. 1.
SYStem.Config debugporttype JTAG
SYStem.Option TRST OFF
SYStem.Option ResBreak OFF      ; On "CVB-257BGA DC", nTRST is connected to nSRST => ResBreak MUST be OFF
SYStem.Option WaitReset 100us   ; Wait 100us (min 50us) between the nSRST/nTRST deassertion and the first JTAG activity
SYStem.JTAGclock 10MHz
SYStem.MemAccess AHB
SYStem.Option DUALPORT ON
trace.DISABLE
ETM.OFF
ITM.OFF
HTM.OFF

SYStem.Up

;SWT_0 Disable
D.S SD:0x40270010 %LE %Long 0xC520
D.S SD:0x40270010 %LE %Long 0xD928
D.S SD:0x40270000 %LE %Long 0xFF000000


;Enable Partition 1
D.S SD:0x402DC300 %LE %LONG 0x00000001  ;  MC_ME.PRTN1_PCONF
D.S SD:0x402DC304 %LE %LONG 0x00000001  ;  MC_ME.PRTN1_PUPD
D.S SD:0x402DC000 %LE %LONG 0x00005AF0  ;  MC_ME.MC_ME_CTL_KEY
D.S SD:0x402DC000 %LE %LONG 0x0000A50F  ;  MC_ME.MC_ME_CTL_KEY
WAIT (Data.Long(SD:0x402DC308)&0x00000001)==0x1  ; MC_ME.PRTN1_STAT[PCS]
(
    ; wait for partition 1 clock to be active
)

PRIVATE &cofb_reg

;Enable DMAMUX_0 Clock
&cofb_reg=Data.Long(SD:0x402DC334)
&cofb_reg=&cofb_reg|0x00000001
D.S SD:0x402DC334 %LE %LONG &cofb_reg   ;  MC_ME.MC_ME_PRTN1_COFB1_CLKEN
D.S SD:0x402DC304 %LE %LONG 0x00000001  ;  MC_ME.PRTN1_PUPD
D.S SD:0x402DC000 %LE %LONG 0x00005AF0  ;  MC_ME.MC_ME_CTL_KEY.R
D.S SD:0x402DC000 %LE %LONG 0x0000A50F  ;  MC_ME.MC_ME_CTL_KEY.R
WAIT (Data.Long(SD:0x402DC314)==&cofb_reg)  ; MC_ME.PRTN1_COFB1_STAT[REQ32]
(
    ; wait for DMAMUX_0 clock to be active
)

;Enable eDMA_TCD_0 Clock
&cofb_reg=Data.Long(SD:0x402DC330)
&cofb_reg=&cofb_reg|0x00000010
D.S SD:0x402DC330 %LE %LONG &cofb_reg   ;  MC_ME.MC_ME_PRTN1_COFB0_CLKEN
D.S SD:0x402DC304 %LE %LONG 0x00000001  ;  MC_ME.PRTN1_PUPD
D.S SD:0x402DC000 %LE %LONG 0x00005AF0  ;  MC_ME.MC_ME_CTL_KEY.R
D.S SD:0x402DC000 %LE %LONG 0x0000A50F  ;  MC_ME.MC_ME_CTL_KEY.R
WAIT (Data.Long(SD:0x402DC310)==&cofb_reg)  ; MC_ME.PRTN1_COFB0_STAT[REQ4]
(
    ; wait for eDMA_TCD_0 clock to be active
)

;DMA SRAM Init
D.S SD:0x40280003 %LE %BYTE 0x80	    ; Channel 0 Enable

D.S SD:0x40210020 %LE %LONG 0x00400000	; SADDR
D.S SD:0x40210024 %LE %LONG 0x03030000	; SSIZE 3, DSIZE 3, SOFF 0
D.S SD:0x40210028 %LE %LONG 0x00050000	; Nbytes
D.S SD:0x4021002C %LE %LONG 0x00000000	; SLAST
D.S SD:0x40210030 %LE %LONG 0x20400000	; DADDR
D.S SD:0x40210034 %LE %LONG 0x00010008	; CITER 1, DOFF 8
D.S SD:0x40210038 %LE %LONG 0xFFFB0000	; DLASTSGA = -NBYTES
D.S SD:0x4021003C %LE %LONG 0x00000001	; Start
WAIT ((data.long(SD:0x40210000)&0x40000000)==0x40000000)
(
    ; wait for DMA DONE bit to be set
)

Data.Load.Elf &elf_file /GLOBTYPES /GT /MW /BUGFIX
; Enable MSCM Clock
&cofb_reg=Data.Long(SD:0x402DC330)
&cofb_reg=&cofb_reg|0x01000000
D.S SD:0x402DC330 %LE %LONG &cofb_reg   ;  MC_ME.MC_ME_PRTN1_COFB0_CLKEN
D.S SD:0x402DC304 %LE %LONG 0x00000001  ;  MC_ME.PRTN1_PUPD
D.S SD:0x402DC000 %LE %LONG 0x00005AF0  ;  MC_ME.MC_ME_CTL_KEY.R
D.S SD:0x402DC000 %LE %LONG 0x0000A50F  ;  MC_ME.MC_ME_CTL_KEY.R
WAIT (Data.Long(SD:0x402DC310)==&cofb_reg)  ; MC_ME.PRTN1_COFB0_STAT[REQ24]
(
    ; wait for MSCM clock to be active
)

List.auto
v.w ui32_ms_cnt task_1 task_2
Register.Set PC Reset_Handler
TASK.CONFIG ~~/demo/arm/kernel/freertos/freertos.t32       ; load FreeRTOS awareness
MENU.ReProgram ~~/demo/arm/kernel/freertos/freertos.men    ; load FreeRTOS menu

ENDDO