;**************************************************************************************
; 
;  Freescale(TM) and the Freescale logo are trademarks of Freescale Semiconductor, Inc. 
;  All other product or service names are the property of their respective owners. 
;  (c) Copyright 2014 - 2015 Freescale Semiconductor Inc.
;  Copyright 2017 NXP
;  All Rights Reserved.
; 
;  You can use this example for any purpose on any computer system with the
;  following restrictions:
;
;  1. This example is provided "as is", without warranty.
;
;  Description: T32 programming script
;
;**************************************************************************************

; Start-Up Script for s32gxxv4
;========================================================================
; CPU setup

local &elfname
entry &elfname



; Load code
; update this patch according to your installation folder
Data.LOAD.ELF Output\image.elf /GLOBTYPES /GT /MW /BUGFIX /NOCODE


v.w ui32_ms_cnt task_1 task_2 task_3 task_4 task_5 task_6 idle_task error_sync timeout uxInterruptNested stmInt int2 svcCnt

; increase trace buffer size
trace.size 10485760.

b.s el1_prefetch_exception
b.s el1_abort_exception
b.s el1_undefined_exception

ENDDO

