;
; Copyright 2018 NXP
;


;local &filename
;entry &filename

&filename="../OUT/DEMO"

;set titles
 Title "Rainier - core_0 (z4) - running &filename ..."

;arrange debugger windows
; framepos      5.    5. 150.  50.

;set equal paths
&pwd=os.pwd()


;=========================================================================
; System settings  
;=========================================================================
; CPU setup
    SYStem.RESet
    SYStem.BdmClock 4.0MHz
    SYStem.DETECT.CPU
    SYStem.CONFIG.CORE 2. 1. ; core_1
    SYStem.CONFIG.Slave OFF
    SYStem.Option.WATCHDOG OFF
    SYStem.Up



;switch to HLL mode debugging
MODE.HLL
  
  
wait 500ms


;initialize internal SRAM.
Data.Set EA:0x40000000--0x4003FFFF %quad 0x0


map.bonchip 0x0--0x4003ffff


DO flash.cmm &filename


;clear all breakpoints
Break.delete /ALL

R.S IP __start

;display source
Data.List
register /sl
;v.w tst_status tst_id tst_current_step tst_last_expected_step

;v.w counter swiInt1On swiInt0On
ENDDO



